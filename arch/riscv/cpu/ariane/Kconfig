## arch/riscv/cpu/ariane/Kconfig
```kconfig
# SPDX-License-Identifier: GPL-2.0+
#
# Copyright (C) 2018, Bin Meng <bmeng.cn@gmail.com>

config OPENPITON_ARIANE
	bool
	select ARCH_EARLY_INIT_R
	select SUPPORT_SPL
	select RAM
	select SPL_RAM if SPL
	imply CPU
	imply CPU_RISCV
	imply RISCV_TIMER if (RISCV_SMODE || SPL_RISCV_SMODE)
	imply SIFIVE_CLINT if (RISCV_MMODE || SPL_RISCV_MMODE)
	imply CMD_CPU
	imply SPL_CPU_SUPPORT
	imply SPL_OPENSBI
	imply SPL_LOAD_FIT
	imply SMP
```

## board/openpiton/ariane/Kconfig
```kconfig
if TARGET_OPENPITON_ARIANE

config SYS_BOARD
	default "ariane"

config SYS_VENDOR
	default "openpiton"

config SYS_CPU
	default "ariane"

config SYS_CONFIG_NAME
	default "openpiton-ariane"

config SYS_TEXT_BASE
	default 0x80200000 if SPL
	default 0x80000000 if !RISCV_SMODE
	default 0x80200000 if RISCV_SMODE

config SPL_TEXT_BASE
	default 0xfff1010000

config SPL_OPENSBI_LOAD_ADDR
	default 0x80000000

config BOARD_SPECIFIC_OPTIONS # dummy
	def_bool y
	select OPENPITON_ARIANE
    imply SPL_RISCV_MMODE

endif
```

## board/openpiton/riscv/Kconfig
```kconfig
if TARGET_OPENPITON_RISCV

config SYS_BOARD
	default "riscv"

config SYS_VENDOR
	default "openpiton"

config SYS_CPU
	default "generic"

config SYS_CONFIG_NAME
	default "openpiton-riscv"

config SYS_TEXT_BASE
	default 0x81000000 if SPL
	default 0x80000000 if !RISCV_SMODE
	default 0x81000000 if RISCV_SMODE

config SPL_TEXT_BASE
	default 0x80000000

config SPL_OPENSBI_LOAD_ADDR
	default 0x81000000

config BOARD_SPECIFIC_OPTIONS # dummy
	def_bool y
	select ARCH_EARLY_INIT_R
	select SUPPORT_SPL
	imply CPU_RISCV
	imply RISCV_TIMER if (RISCV_SMODE || SPL_RISCV_SMODE)
	imply SIFIVE_CLINT if (RISCV_MMODE || SPL_RISCV_MMODE)
	imply CMD_CPU
	imply SPL_CPU_SUPPORT
	imply SPL_OPENSBI
	imply SPL_LOAD_FIT
	imply SPL_SMP
	imply SPL_MMC
	imply SMP
	imply SPL_RISCV_MMODE

endif
```

## configs/openpiton_riscv64_defconfig
```kconfig
CONFIG_RISCV=y
CONFIG_NR_DRAM_BANKS=1
CONFIG_SPL=y
CONFIG_SPL_MMC_SUPPORT=y
CONFIG_DEFAULT_DEVICE_TREE="openpiton-riscv64"
CONFIG_TARGET_OPENPITON_RISCV=y
CONFIG_ARCH_RV64I=y
CONFIG_RISCV_SMODE=y
CONFIG_MISC_INIT_R=n
CONFIG_SYS_MALLOC_F_LEN=0x1000
CONFIG_SPL_SYS_MALLOC_F_LEN=0x100000
CONFIG_SPL_PAYLOAD=""
CONFIG_LIBDISK_SUPPORT=y
CONFIG_NR_CPUS=32
CONFIG_CMODEL_MEDANY=y
CONFIG_EXPORT=n
CONFIG_HASH=n
CONFIG_SPL_SYS_MALLOC_SIMPLE=y
CONFIG_SPL_BANNER_PRINT=n
CONFIG_SPL_CRC32_SUPPORT=n
CONFIG_GENERATE_SMBIOS_TABLE=n
CONFIG_EFI_LOADER=n
CONFIG_LIB_DATA=y
CONFIG_SPL_USE_TINY_PRINTF=y
CONFIG_SPL_TINY_MEMSET=y
CONFIG_FS_EXT4=y
CONFIG_DM_RTC=y
CONFIG_SYS_NS16550=y
CONFIG_SPL_OPENSBI=n
CONFIG_SPL_RTC_SUPPORT=y
CONFIG_SPL_FS_EXT4=y
CONFIG_SPL_LEGACY_IMAGE_SUPPORT=n
CONFIG_CMD_NET=n
CONFIG_EFI_PARTITION=y
CONFIG_EFI_PARTITION_ENTRIES_NUMBERS=128
CONFIG_EFI_PARTITION_ENTRIES_OFF=0
CONFIG_SPL_EFI_PARTITION=y
CONFIG_PARTITION_UUIDS=y
CONFIG_OF_EMBED=y
CONFIG_HAVE_BLOCK_DEVICE=y
CONFIG_CPU=y
CONFIG_CPU_RISCV=y
CONFIG_MMC=y
CONFIG_DM_MMC=y
CONFIG_SPL_DM_MMC=y
CONFIG_MMC_PITON=y
CONFIG_MMC_QUIRKS=y
CONFIG_DEBUG_UART=y
CONFIG_DEBUG_UART_NS16550=y
CONFIG_DEBUG_UART_SHIFT=0
CONFIG_DEBUG_UART_ANNOUNCE=y
CONFIG_DEBUG_UART_SKIP_INIT=y
CONFIG_DEBUG_UART_BASE=0xfff0c2c000
CONFIG_DEBUG_UART_CLOCK=66667000
CONFIG_SPL_LIBDISK_SUPPORT=y
CONFIG_MMC_VERBOSE=n
CONFIG_MMC_WRITE=n
CONFIG_MMC_HW_PARTITIONING=n
CONFIG_SYS_RELOC_GD_ENV_ADDR=n
CONFIG_SAVEENV=n
CONFIG_NET=n
CONFIG_SPL_PARTITION_UUIDS=n
CONFIG_CMD_EXT4=y
CONFIG_CMD_FS_GENERIC=y
CONFIG_CMD_READ=y
CONFIG_CMD_LSBLK=y
CONFIG_CMD_MMC=y
CONFIG_CMD_GPT=y
CONFIG_CMD_MEMINFO=y
CONFIG_EXPERT=n
CONFIG_ENV_VARS_UBOOT_CONFIG=y
CONFIG_LEGACY_IMAGE_FORMAT=n
CONFIG_ARCH_FIXUP_FDT_MEMORY=n
CONFIG_MENU=y
CONFIG_CMD_BOOTZ=y
CONFIG_CMD_PART=y
CONFIG_SHOW_REGS=y
CONFIG_LOG=y
CONFIG_LOGLEVEL=9
CONFIG_SPL_LOGLEVEL=9
CONFIG_TPL_LOGLEVEL=9
CONFIG_SPL_LOG=y
CONFIG_SPL_LOG_MAX_LEVEL=9
CONFIG_SPL_LOG_CONSOLE=y
CONFIG_LOG_ERROR_RETURN=y
CONFIG_CMD_CPU=n
CONFIG_BOOTM_NETBSD=n
CONFIG_BOOTM_PLAN9=n
CONFIG_BOOTM_RTEMS=n
CONFIG_BOOTM_VXWORKS=n
CONFIG_CMD_RUN=n
CONFIG_CMD_IMI=n
CONFIG_CMD_XIMG=n
CONFIG_CMD_EXPORTENV=n
CONFIG_CMD_IMPORTENV=n
CONFIG_CMD_EDITENV=n
CONFIG_CMD_SAVEENV=n
CONFIG_CMD_CRC32=n
CONFIG_CMD_RANDOM=n
CONFIG_CMD_LZMADEC=n
CONFIG_CMD_UNLZ4=n
CONFIG_CMD_UNZIP=n
CONFIG_CMD_FLASH=n
CONFIG_RANDOM_UUID=n
CONFIG_CMD_LOADB=n
CONFIG_CMD_LOADS=n
CONFIG_CMD_ECHO=n
CONFIG_CMD_ITEST=n
CONFIG_CMD_SOURCE=n
CONFIG_CMD_SETEXPR=n
CONFIG_CMD_BLOCK_CACHE=n
CONFIG_CMD_DATE=n
CONFIG_CMD_SLEEP=n
CONFIG_CMD_SYSBOOT=y
CONFIG_CMD_FAT=y
CONFIG_DOS_PARTITION=y
CONFIG_ISO_PARTITION=y
CONFIG_DM_ETH=y
CONFIG_RAM=y
CONFIG_SPL_RAM=y
CONFIG_FS_FAT=y
CONFIG_FS_FAT_MAX_CLUSTSIZE=65536
CONFIG_FS_SQUASHFS=y
CONFIG_SHA1=y
CONFIG_SHA256=y
CONFIG_MD5=y
CONFIG_ZLIB_UNCOMPRESS=y
CONFIG_SPL_GZIP=y
CONFIG_SPL_ZLIB=y
CONFIG_GETOPT=y
CONFIG_OF_LIBFDT_OVERLAY=y
CONFIG_RAM_SIFIVE=n
```

## configs/openpiton_riscv_defconfig
```kconfig
CONFIG_RISCV=y
CONFIG_NR_DRAM_BANKS=1
CONFIG_SPL=y
CONFIG_SPL_MMC_SUPPORT=y
CONFIG_DEFAULT_DEVICE_TREE="openpiton-riscv"
CONFIG_TARGET_OPENPITON_RISCV=y
CONFIG_ARCH_RV64I=y
CONFIG_RISCV_SMODE=y
CONFIG_MISC_INIT_R=n
CONFIG_SYS_MALLOC_F_LEN=0x100000
CONFIG_SPL_PAYLOAD=""
CONFIG_LIBDISK_SUPPORT=y
CONFIG_NR_CPUS=32
CONFIG_CMODEL_MEDANY=y
CONFIG_EXPORT=n
CONFIG_HASH=n
CONFIG_SPL_SYS_MALLOC_SIMPLE=y
CONFIG_SPL_BANNER_PRINT=n
CONFIG_SPL_CRC32_SUPPORT=n
CONFIG_GENERATE_SMBIOS_TABLE=n
CONFIG_EFI_LOADER=n
CONFIG_LIB_DATA=y
CONFIG_SPL_USE_TINY_PRINTF=y
CONFIG_SPL_TINY_MEMSET=y
CONFIG_FS_EXT4=y
CONFIG_DM_RTC=y
CONFIG_SYS_NS16550=y
CONFIG_SPL_OPENSBI=n
CONFIG_SPL_RTC_SUPPORT=y
CONFIG_SPL_FS_EXT4=y
CONFIG_SPL_LEGACY_IMAGE_SUPPORT=n
CONFIG_CMD_NET=n
CONFIG_EFI_PARTITION=y
CONFIG_EFI_PARTITION_ENTRIES_NUMBERS=128
CONFIG_EFI_PARTITION_ENTRIES_OFF=0
CONFIG_SPL_EFI_PARTITION=y
CONFIG_PARTITION_UUIDS=y
CONFIG_OF_EMBED=y
CONFIG_HAVE_BLOCK_DEVICE=y
CONFIG_CPU=y
CONFIG_CPU_RISCV=y
CONFIG_MMC=y
CONFIG_DM_MMC=y
CONFIG_SPL_DM_MMC=y
CONFIG_MMC_PITON=y
CONFIG_MMC_QUIRKS=y
CONFIG_DM_ETH=n
CONFIG_DEBUG_UART=y
CONFIG_DEBUG_UART_NS16550=y
CONFIG_DEBUG_UART_SHIFT=0
CONFIG_DEBUG_UART_ANNOUNCE=y
CONFIG_DEBUG_UART_SKIP_INIT=y
CONFIG_DEBUG_UART_BASE=0xfff0c2c000
CONFIG_DEBUG_UART_CLOCK=66667000
CONFIG_SPL_LIBDISK_SUPPORT=y
CONFIG_MMC_VERBOSE=n
CONFIG_MMC_WRITE=n
CONFIG_MMC_HW_PARTITIONING=n
CONFIG_SYS_RELOC_GD_ENV_ADDR=n
CONFIG_SAVEENV=n
CONFIG_NET=n
CONFIG_SPL_PARTITION_UUIDS=n
CONFIG_CMD_EXT4=y
CONFIG_CMD_FS_GENERIC=y
CONFIG_CMD_READ=y
CONFIG_CMD_LSBLK=y
CONFIG_CMD_MMC=y
CONFIG_CMD_GPT=y
CONFIG_CMD_MEMINFO=y
CONFIG_EXPERT=n
CONFIG_ENV_VARS_UBOOT_CONFIG=y
```

## openpiton_riscv_defconfig
```kconfig
CONFIG_RISCV=y
CONFIG_SPL_GPIO_SUPPORT=y
CONFIG_SYS_MALLOC_F_LEN=0x3000
CONFIG_NR_DRAM_BANKS=1
CONFIG_SPL=y
CONFIG_SPL_MMC_SUPPORT=y
CONFIG_DEFAULT_DEVICE_TREE="openpiton_ariane"
CONFIG_TARGET_OPENPITON_ARIANE=y
CONFIG_ARCH_RV64I=y
CONFIG_RISCV_SMODE=y
CONFIG_DISTRO_DEFAULTS=y
CONFIG_FIT=y
CONFIG_SPL_LOAD_FIT_ADDRESS=0x84000000
CONFIG_MISC_INIT_R=y
```
